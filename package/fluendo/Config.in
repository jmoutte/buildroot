## package/fluendo/Config.in
```kconfig
menu "Fluendo components"
source "package/fluendo/flump3dec/Config.in"
source "package/fluendo/fluilbc/Config.in"
source "package/fluendo/fluadpcm/Config.in"
source "package/fluendo/fluasfdemux/Config.in"
source "package/fluendo/flussdemux/Config.in"
source "package/fluendo/fluaacdec/Config.in"
source "package/fluendo/fluwmadec/Config.in"
source "package/fluendo/fluac3dec/Config.in"
endmenu
```

## package/fluendo/fluaacdec/Config.in
```kconfig
config BR2_PACKAGE_FLUAACDEC
	bool "fluaacdec"
	help
	  Build gst-fluendo-aacdec plugin.
```

## package/fluendo/fluac3dec/Config.in
```kconfig
config BR2_PACKAGE_FLUAC3DEC
	bool "fluac3dec"
	help
	  Build gst-fluendo-ac3dec plugin.
```

## package/fluendo/fluadpcm/Config.in
```kconfig
config BR2_PACKAGE_FLUADPCM
	bool "fluadpcm"
	help
	  Build gst-fluendo-adpcm plugin.
```

## package/fluendo/fluasfdemux/Config.in
```kconfig
config BR2_PACKAGE_FLUASFDEMUX
	bool "fluasfdemux"
	help
	  Build gst-fluendo-asfdemux plugin.
```

## package/fluendo/fluilbc/Config.in
```kconfig
config BR2_PACKAGE_FLUILBC
	bool "fluilbc"
	help
	  Build gst-fluendo-ilbc plugin.
```

## package/fluendo/flump3dec/Config.in
```kconfig
config BR2_PACKAGE_FLUMP3DEC
	bool "flump3dec"
	help
	  Build gst-fluendo-mp3 plugin.
```

## package/fluendo/flussdemux/Config.in
```kconfig
config BR2_PACKAGE_FLUSSDEMUX
	bool "flussdemux"
	help
	  Build gst-fluendo-ssdemux plugin.
```

## package/fluendo/fluwmadec/Config.in
```kconfig
config BR2_PACKAGE_FLUWMADEC
	bool "fluwmadec"
	help
	  Build gst-fluendo-wmadec plugin.
```
